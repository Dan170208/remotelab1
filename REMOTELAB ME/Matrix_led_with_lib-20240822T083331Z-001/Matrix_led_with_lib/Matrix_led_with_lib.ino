/*-----------------------------------code điều khiển LED ma trận---------------------------------------*/
/*
 *  Mạch hiển thị 4 Led ma trận MAX7219.
 *  Nguồn cấp: 5VDC.
 *  Tín hiệu: nối tiếp Serial ba chân DIN, CS, CLK, mức tín hiệu TTL.
 *  Ma trận: 4 Led ma trận 8x8 màu đỏ.
 *  Kích thước: 12.8x3.2x1.3cm.
 */
#include <avr/pgmspace.h>                                 // Khai báo thư viện avr/pgmspace
#include <LedControl.h>                                   // Khai báo thư viện LedControl

const int numDevices = 4;                                 // Khai báo biến numDevice dùng kiểu dữ liệu int
const long scrollDelay = 25;                              // Khai báo biến scrollDelay dùng kiểu dữ liệu long

unsigned long bufferLong [14] = {0};                      // Khai báo biến bufferLong dùng kiểu dữ liệu long            

LedControl lc = LedControl(22, 24, 23, 4);                // Tạo một đối tượng lc của LedControl

typedef unsigned char prog_uchar;                         // Khai báo kiểu dữ liệu 
const prog_uchar scrollText[] PROGMEM = {"  REMOTE LAB "};// Khai báo 1 mảng các kiểu kí tự "prog_uchar" tên là scrollText và khởi tạo nó ra chữ "REMOTELED"

void setup()                                              // code ghi trong đây sẽ chỉ chạy 1 lần, đây là điểm bắt đầu của code
{
  for (int x=0; x < numDevices; x++)                      // tạo vòng lặp for
  {
    lc.shutdown(x, false);                                //Bật tất cả các ma trận LED.
    lc.setIntensity(x, 0);                                //Đặt độ sáng của tất cả các ma trận LED về 0.
    lc.clearDisplay(x);                                   //Xóa toàn bộ nội dung trên tất cả các ma trận LED.
  }
  lc.setIntensity(2, 15);                                 //Đặt độ sáng của ma trận LED thứ 2 lên 15 (giá trị tối đa).
  lc.setIntensity(1, 15);                                 //Đặt độ sáng của ma trận LED thứ 3 lên 15 (giá trị tối đa)
}

void loop()
{ 
  scrollMessage(scrollText);                              // Gọi hàm scrollMessage để hiển thị chuỗi "REMOTE LAB" trên ma trận LED.
}

const prog_uchar font5x7 [] PROGMEM = 
{
    B00000000,  //Space (Char 0x20)                   /*   //Mảng 2 chiều: Mỗi ký tự được biểu diễn bởi một mảng 8 byte, 
    B00000000,                                         -   //mỗi byte tương ứng với một hàng của ma trận LED.
    B00000000,                                         -   //Giá trị 0 và 1: 0 đại diện cho điểm ảnh tắt,
    B00000000,         //---giải thích---//            -   //1 đại diện cho điểm ảnh sáng.
    B00000000,                                         -   //Ví dụ: Ký tự 'A' được biểu diễn bởi một mảng 8 byte,
    B00000000,                                         -   //mỗi byte tương ứng với một hàng của chữ A khi hiển thị trên ma trận LED.
    B00000000,                                        */
    6,

    B10000000,  //!
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    B00000000,
    5
};

void scrollFont()                                   //Hàm này dùng để hiển thị tất cả các ký tự có trong mảng font chữ.
{
  for (int counter=0x20; counter<0x80; counter++)
  {
    loadBufferLong(counter);
    delay(500);
  }
}

void scrollMessage(prog_uchar * messageString)    //Hàm này nhận vào một chuỗi ký tự và hiển thị từng ký tự lên ma trận LED.
{
  int counter = 0;
  int myChar=0;
  do 
  {
    myChar =  pgm_read_byte_near(messageString + counter); 
    if (myChar != 0)
    {
      loadBufferLong(myChar);
    }
    counter++;
  } 
  while (myChar != 0);
}

void loadBufferLong(int ascii)                  // Hàm này lấy một mã ASCII của một ký tự, tìm kiếm thông tin về ký tự đó trong mảng font chữ và lưu trữ thông tin vào một mảng buffer.
{
  if (ascii >= 0x20 && ascii <=0x7f)
  {
    for (int a=0;a<7;a++)
    {
      unsigned long c = pgm_read_byte_near(font5x7 + ((ascii - 0x20) * 8) + a);
      unsigned long x = bufferLong [a*2];
      x = x | c;
      bufferLong [a*2] = x;
    }
    byte count = pgm_read_byte_near(font5x7 +((ascii - 0x20) * 8) + 7);
    for (byte x=0; x<count;x++)
    {
      rotateBufferLong();
      printBufferLong();
      delay(scrollDelay);
    }
  }
}

void rotateBufferLong()                        //Hàm này dịch chuyển các bit trong mảng buffer để tạo hiệu ứng cuộn.
{
  for (int a=0;a<7;a++)
  {
    unsigned long x = bufferLong [a*2];
    byte b = bitRead(x,31);
    x = x<<1;
    bufferLong [a*2] = x;
    x = bufferLong [a*2+1];
    x = x<<1;
    bitWrite(x,0,b);
    bufferLong [a*2+1] = x;
  }
}  

void printBufferLong()                       //Hàm này lấy dữ liệu từ mảng buffer và hiển thị lên ma trận LED.
{
  for (int a=0;a<7;a++)
  {
    unsigned long x = bufferLong [a*2+1];
    byte y = x;
    lc.setRow(3,a,y);
    x = bufferLong [a*2];
    y = (x>>24);
    lc.setRow(2,a,y);
    y = (x>>16);
    lc.setRow(1,a,y);
    y = (x>>8);
    lc.setRow(0,a,y);
  }
}
